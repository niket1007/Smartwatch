## sdkconfig.defaults
```kconfig
# ==========================================
# 1. WAVESHARE HARDWARE BASE & PSRAM CONFIG
# ==========================================
CONFIG_ESPTOOLPY_FLASHMODE_QIO=y
CONFIG_ESPTOOLPY_FLASHSIZE_16MB=y
CONFIG_PARTITION_TABLE_CUSTOM=y
CONFIG_COMPILER_OPTIMIZATION_PERF=y

# 8MB Octal PSRAM Setup
CONFIG_SPIRAM=y
CONFIG_SPIRAM_MODE_OCT=y
CONFIG_SPIRAM_FETCH_INSTRUCTIONS=y
CONFIG_SPIRAM_RODATA=y
CONFIG_SPIRAM_SPEED_80M=y
CONFIG_ESP32S3_DATA_CACHE_LINE_64B=y
CONFIG_ESP_DEFAULT_CPU_FREQ_MHZ_240=y

# Arduino Core Requirement (MUST BE 1000)
CONFIG_FREERTOS_HZ=1000
CONFIG_AUTOSTART_ARDUINO=y

# ==========================================
# 2. SMARTWATCH POWER MANAGEMENT
# ==========================================
CONFIG_PM_ENABLE=y
CONFIG_FREERTOS_USE_TICKLESS_IDLE=y
CONFIG_FREERTOS_IDLE_TIME_BEFORE_SLEEP=3
CONFIG_PM_LIGHT_SLEEP_CALLBACKS=y
CONFIG_PM_PROFILING=y

# ==========================================
# 3. BLUETOOTH (NimBLE)
# ==========================================
CONFIG_BT_ENABLED=y
CONFIG_BT_CONTROLLER_ENABLED=y
CONFIG_BT_CONTROLLER_MODE_BLE_ONLY=y

# Force NimBLE stack and disable Bluedroid
CONFIG_BT_NIMBLE_ENABLED=y
CONFIG_BT_BLUEDROID_ENABLED=n
CONFIG_BT_NIMBLE_SLEEP_ENABLE=y
CONFIG_BT_NIMBLE_MEM_ALLOC_MODE_EXTERNAL=y
CONFIG_ESP32_WIFI_SW_COEXIST_ENABLE=y

# Enable Bluetooth Controller Modem Sleep
CONFIG_BT_CTRL_MODEM_SLEEP=y
CONFIG_BT_CTRL_MODEM_SLEEP_MODE_1=y
CONFIG_BT_CTRL_LPCLK_SEL_MAIN_XTAL=y
CONFIG_BT_CTRL_MAIN_XTAL_PU_DURING_LIGHT_SLEEP=y

# Enable MAC and Baseband Power Down during sleep
CONFIG_MAC_BB_PD=y
CONFIG_ESP32_PHY_MAC_BB_PD=y
CONFIG_ESP_PHY_MAC_BB_PD=y

# ==========================================
# 4. WiFi
# ==========================================
CONFIG_ESP32_WIFI_SW_COEXIST_ENABLE=y
```
